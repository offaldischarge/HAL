/dts-v1/;
/plugin/;

/ {
    compatible = "brcm,bcm2835", "brcm,bcm2708";
    /* disable spi-dev for spi0.0 */
    fragment@0 {
        target = <&spi0>; // SPI Bus 0
        __overlay__ {
            status = "okay";
            spidev@0{     // SPI Chip Select 0
                status = "disabled";
            };
        };
    };

    fragment@1 {
        target = <&spi0>; // SPI Bus 0
        __overlay__ {
            /* needed to avoid dtc warning */
            #address-cells = <1>;
            #size-cells = <0>;
            spi_drv:spi_drv@0 {
                compatible = "ase, spi_drv";
                reg = <1>; // SPI Chip Select 1
                gpios = <&gpio 5 1>; /* LDAC GPIO angives for DAC */
                spi-cpha = <0>; /* CPHA0 */
                spi-cpol = <0>; /* CPOL0 */
                spi-max-frequency = <20000000>; /* Max speed: 20MHz */
            };
        };
    };
};
